## firmware/main/Kconfig.projbuild
```kconfig
menu "Tepy"
    config TEPY_SERIAL_ENABLED
        bool "USB Serial/JTAG management protocol"
        default y
        depends on ESP_CONSOLE_USB_SERIAL_JTAG || ESP_CONSOLE_SECONDARY_USB_SERIAL_JTAG
        help
            Authenticated framed JSON management for the Qt client over the
            native USB port. UART console output alone is not this interface.

    config TEPY_HID_DEVICE_INFORMATION
        bool
        default y
        depends on BT_NIMBLE_ENABLED && BT_NIMBLE_HID_SERVICE
        select BT_NIMBLE_DIS_SERVICE
        select BT_NIMBLE_SVC_DIS_PNP_ID
        select BT_NIMBLE_SVC_DIS_MANUFACTURER_NAME
        select BT_NIMBLE_SVC_DIS_SERIAL_NUMBER
        select BT_NIMBLE_SVC_DIS_FIRMWARE_REVISION
        help
            HID over GATT requires PnP ID. Select it even in existing sdkconfig
            files that explicitly disabled DIS fields. Defaults alone do not
            override saved configuration values.

    config TEPY_RECOVERY_GPIO
        int "Recovery button GPIO (active low)"
        range 0 48
        default 0
endmenu
```
